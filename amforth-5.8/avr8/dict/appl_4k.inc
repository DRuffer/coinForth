.include "words/ver.asm"

;;;;;;;;;;;;;;;;;;;;;;;;;;;;;;;;;
.include "words/noop.asm"
.include "words/unused.asm"
.include "words/to.asm"
.include "words/icompare.asm"
.include "words/star.asm"
.include "words/j.asm"
.include "words/dabs.asm"
.include "words/dnegate.asm"
.include "words/cmove.asm"
.include "words/2swap.asm"
.include "words/tib.asm"
.include "words/init-user.asm"
;;;;;;;;;;;;;;;;;;;;;;;;;;;;;;;;;


.include "words/environment.asm"
.include "words/env-wordlists.asm"
.include "words/env-slashpad.asm"
.include "words/env-slashhold.asm"
.include "words/env-forthname.asm"
.include "words/env-forthversion.asm"
.include "words/env-cpu.asm"
.include "words/env-mcuinfo.asm"
.include "words/env-usersize.asm"
;;;;;;;;;;;;;;;;;;;;;;;;;;;;;;;;;;;;;;;;;;
.include "words/hld.asm"
.include "words/hold.asm"
.include "words/less-sharp.asm" ; <#
.include "words/sharp.asm"
.include "words/sharp-s.asm"
.include "words/sharp-greater.asm" ; #>
.include "words/sign.asm"
.include "words/d-dot-r.asm"
.include "words/dot-r.asm"
.include "words/d-dot.asm"
.include "words/dot.asm"
.include "words/ud-dot.asm"
.include "words/ud-dot-r.asm"
.include "words/ud-slash-mod.asm"
.include "words/digit-q.asm"
;;;;;;;;;;;;;;;;;;;;;;;;;;;;;;;;
.include "words/do-sliteral.asm"
.include "words/scomma.asm"
.include "words/itype.asm"
.include "words/icount.asm"
.include "words/type.asm"
.include "words/tick.asm"
;;;;;;;;;;;;;;;;;;;;;;;;;;;;;;;;
.include "words/cskip.asm"
.include "words/cscan.asm"
.include "words/accept.asm"
.include "words/refill.asm"
.include "words/char.asm"
.include "words/number.asm"
.include "words/q-sign.asm"
.include "words/set-base.asm"
.include "words/to-number.asm"
.include "words/parse.asm"
.include "words/source.asm"
.include "words/slash-string.asm"
.include "words/parse-name.asm"
.include "words/sp0.asm"
.include "words/rp0.asm"
.include "words/depth.asm"
.include "words/do-recognizer.asm"
.include "words/interpret.asm"
.include "words/r-intnumber.asm"
.include "words/r-word.asm"
.include "words/r-fail.asm"
.include "words/search-wordlist.asm"
.include "words/traverse-wordlist.asm"
.include "words/name2string.asm"
.include "words/nfa2cfa.asm"
.include "words/find-name.asm"

.include "dict/compiler1.inc"
