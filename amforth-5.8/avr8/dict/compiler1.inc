
.include "words/docreate.asm"
.include "words/backslash.asm"
.include "words/l-paren.asm"

.include "words/compile.asm"
.include "words/comma.asm"
.include "words/brackettick.asm"


.include "words/literal.asm"
.include "words/sliteral.asm"
.include "words/g-mark.asm"
.include "words/g-resolve.asm"
.include "words/l_mark.asm"
.include "words/l_resolve.asm"

.include "words/ahead.asm"
.include "words/if.asm"
.include "words/else.asm"
.include "words/then.asm"
.include "words/begin.asm"
.include "words/while.asm"
.include "words/repeat.asm"
.include "words/until.asm"
.include "words/again.asm"
.include "words/do.asm"
.include "words/loop.asm"
.include "words/plusloop.asm"
.include "words/leave.asm"
.include "words/qdo.asm"
.include "words/endloop.asm"
; leave address stack
.include "words/l-from.asm"
.include "words/to-l.asm"
.include "words/lp0.asm"
.include "words/lp.asm"

.include "words/create.asm"
.include "words/header.asm"
.include "words/wlscope.asm"
.include "words/reveal.asm"
.include "words/latest.asm"
.include "words/does.asm"
.include "words/colon.asm"
.include "words/colon-noname.asm"
.include "words/semicolon.asm"
.include "words/right-bracket.asm"
.include "words/left-bracket.asm"
.include "words/variable.asm"
.include "words/constant.asm"
.include "words/user.asm"

.include "words/recurse.asm"
.include "words/immediate.asm"

.include "words/bracketchar.asm"
.include "words/abort-string.asm"
.include "words/abort.asm"
.include "words/q-abort.asm"

.include "words/get-stack.asm"
.include "words/set-stack.asm"
.include "words/map-stack.asm"
.include "words/get-current.asm"
.include "words/get-order.asm"

.include "words/compare.asm"
.include "words/nfa2lfa.asm"
